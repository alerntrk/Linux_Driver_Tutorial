/dts-v1/;
/plugin/;
/ {
	compatible = "qcom,kona";
	fragment@0 {
		target = <&i2c1>;
		__overlay__ {
			#address-cells = <1>;
			#size-cells = <0>;

			cam: cam@28 {
				compatible = "omni,ov9282";
				reg = <0x28>;
				status = "okay";
			};
		};
	};
};
